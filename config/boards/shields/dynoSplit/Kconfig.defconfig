## config/boards/shields/dynoSplit/Kconfig.defconfig
```kconfig
if SHIELD_DYNOSPLIT_LEFT

config ZMK_KEYBOARD_NAME
    default "dynoSplit"

config ZMK_SPLIT_ROLE_CENTRAL
    default y

endif

if SHIELD_DYNOSPLIT_LEFT || SHIELD_DYNOSPLIT_RIGHT

config ZMK_SPLIT
    default y

endif
```

## config/boards/shields/dynoSplit/Kconfig.shield
```kconfig
config SHIELD_DYNOSPLIT_LEFT
    def_bool $(shields_list_contains,dynoSplit_left)

config SHIELD_DYNOSPLIT_RIGHT
    def_bool $(shields_list_contains,dynoSplit_right)
```
